## Kconfig
```kconfig
menu "Board Common"

    config BOARD_LANDSCAPE
        bool "Landscape orientation"
        default n
        help
            Rotate the display 90 degrees for landscape orientation.

            When enabled, LVGL sees swapped dimensions (V_RES x H_RES)
            and the board init code applies the appropriate flush callback
            rotation and touch coordinate transforms.

            The convenience macros BOARD_DISP_H_RES / BOARD_DISP_V_RES
            reflect the logical (post-rotation) dimensions.

    config BOARD_CSI_AE_TARGET
        int "CSI camera auto-exposure target (0 = ISP default)"
        default 110
        range 0 235
        help
            Auto-exposure setpoint for the CSI (OV5647) ISP pipeline, 2-235.
            Higher = brighter; 128 = neutral. 0 leaves the ISP/sensor default.

            Decode is a BAND in captured-crop brightness, not a "brighter is
            better" ramp: it wants crop mean ~168-180 and falls off at BOTH
            ends. Too dim and the AEC reaches for analog gain, whose read-noise
            swamps the black/white module separation; too bright and clipped
            highlights eat into that separation from the other side.

            110 lands mid-band on the two panel types that matter most for
            on-screen scanning -- measured decode-rate 1.00 on a mounted 32" VA
            viewed on-axis (crop mean 180), and 1.00 on a MacBook at -3 (crop
            mean 168-177). Prior guidance here suggested ~60-80; sweeps show
            that range yields crop mean ~110-155 and decode-rate 0.00, so do
            not go there.

            NB: the AEC meters the whole frame while the decoder only sees the
            centre crop, so the target needed for a given crop mean shifts with
            how bright the surround is -- re-measure if the framing changes
            substantially. Applied at camera start.

endmenu
```

## apps/camera_capture/sdkconfig.defaults
```kconfig
# camera_capture — shared settings for all boards

# Partition table — 2MB app slot (default 1MB is too tight) + coredump
CONFIG_PARTITION_TABLE_CUSTOM=y
CONFIG_PARTITION_TABLE_CUSTOM_FILENAME="partitions.csv"
CONFIG_PARTITION_TABLE_FILENAME="partitions.csv"

# Core dump to flash — captures crash backtraces
CONFIG_ESP_COREDUMP_ENABLE_TO_FLASH=y
CONFIG_ESP_COREDUMP_DATA_FORMAT_ELF=y
CONFIG_ESP_COREDUMP_CHECKSUM_CRC32=y
CONFIG_ESP_COREDUMP_CAPTURE_DRAM=y

# Task watchdog
CONFIG_ESP_TASK_WDT_TIMEOUT_S=10

# CSI camera (ESP32-P4 boards with OV5647)
CONFIG_CAMERA_OV5647=y
CONFIG_CAMERA_OV5647_MIPI_RAW10_1280x960_BINNING_45FPS=y
CONFIG_ESP_VIDEO_ENABLE_ISP_PIPELINE_CONTROLLER=y
# Allow CSI driver to allocate its internal backup buffer for DMA safety
# CONFIG_ESP_VIDEO_DISABLE_MIPI_CSI_DRIVER_BACKUP_BUFFER is not set

# Disable task WDT — camera DQBUF blocks the idle task
CONFIG_ESP_TASK_WDT_EN=n
# FreeRTOS timer task needs more stack for camera/ISP
CONFIG_FREERTOS_TIMER_TASK_STACK_DEPTH=4096

# Debug metrics
CONFIG_CAM_PIPELINE_DEBUG=y

# LVGL fonts (for review-mode save/discard button labels)
CONFIG_LV_FONT_MONTSERRAT_14=y
CONFIG_LV_FONT_MONTSERRAT_24=y
```

## apps/entropy_test/sdkconfig.defaults
```kconfig
# entropy_test — shared settings for all boards

# Partition table
CONFIG_PARTITION_TABLE_CUSTOM=y
CONFIG_PARTITION_TABLE_CUSTOM_FILENAME="partitions.csv"
CONFIG_PARTITION_TABLE_FILENAME="partitions.csv"

# Task watchdog
CONFIG_ESP_TASK_WDT_TIMEOUT_S=10

# CSI camera (ESP32-P4 boards with OV5647)
CONFIG_CAMERA_OV5647=y
CONFIG_CAMERA_OV5647_MIPI_RAW10_1280x960_BINNING_45FPS=y
CONFIG_ESP_VIDEO_ENABLE_ISP_PIPELINE_CONTROLLER=y

# Disable task WDT — camera DQBUF blocks the idle task
CONFIG_ESP_TASK_WDT_EN=n
# FreeRTOS timer task needs more stack for camera/ISP
CONFIG_FREERTOS_TIMER_TASK_STACK_DEPTH=4096

# CSI auto-exposure target (0 = ISP default)
CONFIG_BOARD_CSI_AE_TARGET=0

# Hardware SHA-256 acceleration (ESP32-P4 SHA peripheral) for frame hashing
CONFIG_MBEDTLS_HARDWARE_SHA=y

# Pipeline fps HUD ON — confirms preview frames are flowing during hashing.
CONFIG_CAM_PIPELINE_DEBUG=y

# LVGL fonts
CONFIG_LV_FONT_MONTSERRAT_14=y
CONFIG_LV_FONT_MONTSERRAT_24=y

# Core dump to flash — captures crash backtraces for post-mortem analysis
CONFIG_ESP_COREDUMP_ENABLE_TO_FLASH=y
CONFIG_ESP_COREDUMP_DATA_FORMAT_ELF=y
CONFIG_ESP_COREDUMP_CHECKSUM_CRC32=y
CONFIG_ESP_COREDUMP_CAPTURE_DRAM=y

# Boot log to flash — captures complete boot log, survives reboot
CONFIG_BOARD_LOG_TO_FLASH=y
```

## apps/qr_decoder/sdkconfig.defaults
```kconfig
# QR decoder — shared settings for all boards

# Partition table
CONFIG_PARTITION_TABLE_CUSTOM=y
CONFIG_PARTITION_TABLE_CUSTOM_FILENAME="partitions.csv"
CONFIG_PARTITION_TABLE_FILENAME="partitions.csv"

# Task watchdog
CONFIG_ESP_TASK_WDT_TIMEOUT_S=10

# CSI camera (ESP32-P4 boards with OV5647)
CONFIG_CAMERA_OV5647=y
CONFIG_CAMERA_OV5647_MIPI_RAW10_1280x960_BINNING_45FPS=y
CONFIG_ESP_VIDEO_ENABLE_ISP_PIPELINE_CONTROLLER=y
# Allow CSI driver to allocate its internal backup buffer for DMA safety
# CONFIG_ESP_VIDEO_DISABLE_MIPI_CSI_DRIVER_BACKUP_BUFFER is not set

# Disable task WDT — camera DQBUF blocks the idle task
CONFIG_ESP_TASK_WDT_EN=n
# FreeRTOS timer task needs more stack for camera/ISP
CONFIG_FREERTOS_TIMER_TASK_STACK_DEPTH=4096

# QR decoder tuning
# k_quirc (fork submodule) hardcodes MAX_VERSION=25 in k_quirc.h — its version DB
# is only populated through v25 (covers 2-of-3 v15, UR animated baseline v17,
# 3-of-5 v19, BBQr-low v18; BBQr-max v27 needs the DB extended). MAX_VERSION /
# ADAPTIVE_THRESHOLD are no longer Kconfig knobs in the fork. Contrast stretch is.
# See docs/qr-scanning-performance-requirements.md and
# docs/knowledge/k-quirc-max-version-db-bound.md.
CONFIG_K_QUIRC_CONTRAST_STRETCH=y

# Decode-resolution sweep knob (0 = auto/480). Set per sweep build.
CONFIG_QR_DECODE_SQUARE=0

# CSI auto-exposure target — dial exposure back so bright laptop-screen QR
# highlights don't clip (blowout). 0 = ISP default (over-exposes screens).
CONFIG_BOARD_CSI_AE_TARGET=70

# Debug metrics
CONFIG_CAM_PIPELINE_DEBUG=y
CONFIG_CAM_PIPELINE_QR_DEBUG=y

# LVGL fonts
CONFIG_LV_FONT_MONTSERRAT_14=y
CONFIG_LV_FONT_MONTSERRAT_24=y

# Core dump to flash — captures crash backtraces for post-mortem analysis
CONFIG_ESP_COREDUMP_ENABLE_TO_FLASH=y
CONFIG_ESP_COREDUMP_DATA_FORMAT_ELF=y
CONFIG_ESP_COREDUMP_CHECKSUM_CRC32=y
CONFIG_ESP_COREDUMP_CAPTURE_DRAM=y

# Boot log to flash — captures complete boot log, survives reboot
CONFIG_BOARD_LOG_TO_FLASH=y
```

## apps/scan_coord_test/main/Kconfig.projbuild
```kconfig
menu "QR decoder spike"

    config QR_DECODE_SQUARE
        int "PPA output / QR decode square size (px, 0 = auto)"
        default 0
        range 0 800
        help
            Side length of the square frame the camera PPA produces and that
            the QR consumer (quirc) runs on. This is the Phase-1 spike's master
            knob: smaller = faster quirc + less PSRAM traffic, bounded below by
            >=3 px/module for the worst-case QR.

            0 means "auto": use the shorter logical display dimension (the
            previous hardcoded behavior). Any non-zero value overrides it, so
            the sweep can be driven per-build from sdkconfig with no source
            edits. Typical sweep points: 480, 320, 240.

endmenu
```

## boards/waveshare_p4_lcd35/sdkconfig.defaults
```kconfig
# Waveshare ESP32-P4 WiFi6 Touch LCD 3.5
CONFIG_IDF_TARGET="esp32p4"
CONFIG_ESPTOOLPY_FLASHMODE_QIO=y
CONFIG_ESPTOOLPY_FLASHFREQ_80M=y
CONFIG_ESPTOOLPY_FLASHSIZE_16MB=y
CONFIG_SPIRAM=y
CONFIG_SPIRAM_MODE_OCT=y
CONFIG_SPIRAM_SPEED_80M=y
CONFIG_COMPILER_OPTIMIZATION_PERF=y

# SPI display requires ISR in IRAM so SPI transaction interrupts are not
# blocked by flash cache misses. Without this, display DMA from SPIRAM fails.
CONFIG_SPI_MASTER_ISR_IN_IRAM=y

# FreeRTOS tick rate (needed for smooth LVGL rendering; matches P4 LCD 4.3)
CONFIG_FREERTOS_HZ=1000

# Disable power management: PM clock gating can scale down APB clock and
# gate SPI peripheral clocks, causing display transactions to fail.
CONFIG_PM_ENABLE=n

# Enable USB serial/JTAG console for serial output (same fix as P4 LCD 4.3)
CONFIG_ESP_CONSOLE_SECONDARY_USB_SERIAL_JTAG=y
```

## components/board_log_flash/Kconfig
```kconfig
menu "Flash Log"

    config BOARD_LOG_TO_FLASH
        bool "Boot log to flash"
        default n
        help
            Capture all ESP_LOGx output to a flash partition ("log_store").
            The previous boot's log is dumped to serial on startup.
            Requires a "log_store" data partition (subtype 0x42, 64KB+)
            in the partition table.

endmenu
```
